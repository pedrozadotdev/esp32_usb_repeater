## firmware/main/Kconfig.projbuild
```kconfig
menu "USB Repeater Configuration"

    config ENABLE_LOG_HANDLER
        bool "Enable Log Handler"
        default y
        help
            Enable the log handler feature which stores logs in memory.
            When enabled, logs will be stored in RTC memory and can be accessed
            via the HTTP server or through log_write() function.
            
            If disabled, log_write() calls will be no-ops and log-related
            functionality will be compiled out.

    config ENABLE_HTTP_SERVER
        bool "Enable HTTP Log Server"
        default y
        depends on ENABLE_LOG_HANDLER
        help
            Enable the HTTP server on port 8080 for accessing logs remotely.
            
            The HTTP server provides endpoints for:
            - GET /logs - View all logs
            - GET /clear - Clear logs
            - GET / - Redirect to /logs
            
            Note: This option requires ENABLE_LOG_HANDLER to be enabled.
            If disabled, the HTTP server will not be compiled or started.

    menu "WiFi Configuration"

        config USB_REPEATER_WIFI_SSID
            string "WiFi SSID"
            default "myssid"
            help
                SSID (network name) for the device to connect to.
                This is the WiFi network name that the ESP32 will attempt to connect to.
                
                Maximum length: 32 characters

        config USB_REPEATER_WIFI_PASSWORD
            string "WiFi Password"
            default "mypassword"
            help
                WiFi password (WPA or WPA2) for the network.
                
                Leave empty for open networks (no password).
                Maximum length: 64 characters

        config USB_REPEATER_WIFI_MAX_RETRY
            int "Maximum WiFi Connection Retry"
            default 6
            range 1 255
            help
                Maximum number of times to retry WiFi connection before giving up.
                After this many failed attempts, the device will stop trying to connect.

        # Override the example component's WiFi configuration with our values
        config EXAMPLE_WIFI_SSID
            string
            default USB_REPEATER_WIFI_SSID

        config EXAMPLE_WIFI_PASSWORD
            string
            default USB_REPEATER_WIFI_PASSWORD

        config EXAMPLE_WIFI_CONN_MAX_RETRY
            int
            default USB_REPEATER_WIFI_MAX_RETRY

    endmenu

endmenu
```

## firmware/sdkconfig.defaults
```kconfig
# ESP32 USB Repeater - Default Configuration Template
# 
# This file contains the default configuration WITHOUT WiFi credentials.
# Copy this to firmware/sdkconfig.defaults and run 'idf.py menuconfig' to set WiFi credentials.
#
# The actual sdkconfig file (containing WiFi credentials) is in .gitignore
# to prevent accidentally committing sensitive information.

#
# Target Configuration
#
CONFIG_IDF_TARGET="esp32s2"
CONFIG_IDF_TARGET_ESP32S2=y

#
# USB Repeater Configuration
#

# Feature Flags
CONFIG_ENABLE_LOG_HANDLER=n
CONFIG_ENABLE_HTTP_SERVER=n

# WiFi Configuration
# IMPORTANT: Set these values using 'idf.py menuconfig'
# Navigate to: USB Repeater Configuration → WiFi Configuration
CONFIG_USB_REPEATER_WIFI_SSID="your-ssid"
CONFIG_USB_REPEATER_WIFI_PASSWORD="your-password"
CONFIG_USB_REPEATER_WIFI_MAX_RETRY=6

#
# ESP32-specific Configuration
#
CONFIG_ESPTOOLPY_FLASHMODE_QIO=y
CONFIG_ESPTOOLPY_FLASHFREQ_80M=y
CONFIG_ESPTOOLPY_FLASHSIZE_4MB=y

#
# Compiler Options
#
CONFIG_COMPILER_OPTIMIZATION_SIZE=y
CONFIG_COMPILER_OPTIMIZATION_ASSERTIONS_ENABLE=y

#
# FreeRTOS
#
CONFIG_FREERTOS_HZ=1000

#
# Log output
#
CONFIG_LOG_DEFAULT_LEVEL_INFO=y
CONFIG_LOG_MAXIMUM_LEVEL_VERBOSE=y

#
# Component config → Wi-Fi
#
CONFIG_ESP_WIFI_STATIC_RX_BUFFER_NUM=10
CONFIG_ESP_WIFI_DYNAMIC_RX_BUFFER_NUM=32
CONFIG_ESP_WIFI_DYNAMIC_TX_BUFFER=y
CONFIG_ESP_WIFI_DYNAMIC_TX_BUFFER_NUM=32
CONFIG_ESP_WIFI_AMPDU_TX_ENABLED=y
CONFIG_ESP_WIFI_AMPDU_RX_ENABLED=y
CONFIG_ESP_WIFI_NVS_ENABLED=y

#
# Example Connection Configuration
# These are overridden by USB_REPEATER_WIFI_* settings
#
CONFIG_EXAMPLE_WIFI_SCAN_METHOD_ALL_CHANNEL=y
CONFIG_EXAMPLE_WIFI_CONNECT_AP_BY_SIGNAL=y
```
